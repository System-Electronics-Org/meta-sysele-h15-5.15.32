## recipes-bsp/u-boot/files/arch/arm/mach-hailo/Kconfig.patch
```kconfig
--- a/arch/arm/mach-hailo/Kconfig
+++ b/arch/arm/mach-hailo/Kconfig
@@ -416,6 +416,10 @@ config TARGET_HAILO12L_MAPLE
 	bool "Hailo12L Maple"
 	select MACH_HAILO12L
 
+config TARGET_ASTRIAL_H15
+	bool "Astrial H15 Development Board"
+	select MACH_HAILO15
+
 source "board/hailo/hailo15-vp/Kconfig"
 source "board/hailo/hailo15-ginger-soc/Kconfig"
 source "board/hailo/hailo15-ginger-soc-sdio0/Kconfig"
@@ -439,5 +443,6 @@ source "board/hailo/hailo12l-evb/Kconfig"
 source "board/hailo/hailo12l-veloce/Kconfig"
 source "board/hailo/hailo12l-mint/Kconfig"
 source "board/hailo/hailo12l-maple/Kconfig"
+source "board/sysele/astrial-h15/Kconfig"
 
 endif
```

## recipes-bsp/u-boot/files/board/sysele/astrial-h15/Kconfig
```kconfig
if TARGET_ASTRIAL_H15

config SYS_BOARD
	default "astrial-h15"

config SYS_VENDOR
	default "sysele"

config SYS_CONFIG_NAME
	default "astrial-h15"

endif
```

## recipes-bsp/u-boot/files/configs/astrial-h15_defconfig
```kconfig
CONFIG_ARM=y
CONFIG_ARCH_HAILO=y
CONFIG_TARGET_ASTRIAL_H15=y
CONFIG_DEFAULT_DEVICE_TREE="astrial-h15"
CONFIG_SPI_FLASH_ISSI=y
CONFIG_SPI_FLASH_WINBOND=y
CONFIG_SPI_FLASH_MACRONIX=y
```
