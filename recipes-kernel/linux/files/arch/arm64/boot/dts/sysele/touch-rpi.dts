// SPDX-License-Identifier: GPL-2.0-only
/dts-v1/;
/plugin/;

&i2c_2 {
    #address-cells = <1>;
    #size-cells = <0>;

    touchscreen@38 {
        compatible = "edt,edt-ft5506";
        reg = <0x38>;
        touchscreen-size-x = <800>;
        touchscreen-size-y = <480>;
        touchscreen-inverted-x;
        touchscreen-inverted-y;
        status = "okay";
    };
};
