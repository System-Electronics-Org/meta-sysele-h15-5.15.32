// SPDX-License-Identifier: GPL-2.0
/dts-v1/;
/plugin/;

&i2c_2 {
    touchscreen@14 {
        compatible = "goodix,gt9271";
        reg = <0x14>;
        touchscreen-size-x = <800>;
        touchscreen-size-y = <1280>;
        touchscreen-inverted-x;
        touchscreen-swapped-x-y;
    };
};
